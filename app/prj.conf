## CMakeLists.txt
```
#-------------------------------------------------------------------------------
# Zephyr Example Application
#
# Copyright (c) 2021 Nordic Semiconductor ASA
# SPDX-License-Identifier: Apache-2.0

cmake_minimum_required(VERSION 3.13.1)
find_package(Zephyr REQUIRED HINTS $ENV{ZEPHYR_BASE})

project(app LANGUAGES C)

FILE(GLOB app_sources src/*.c)
FILE(GLOB dir_sources src/**/*.c)

target_sources(app PRIVATE 
    ${app_sources};
    ${dir_sources}
)
```

## Kconfig
```
# Copyright (c) 2021 Nordic Semiconductor ASA
# SPDX-License-Identifier: Apache-2.0
#
# This file is the application Kconfig entry point. All application Kconfig
# options can be defined here or included via other application Kconfig files.
# You can browse these options using the west targets menuconfig (terminal) or
# guiconfig (GUI).

menu "Zephyr"
source "Kconfig.zephyr"
endmenu

module = APP
module-str = APP
source "subsys/logging/Kconfig.template.log_config"

rsource "src/ble/Kconfig.ble"
```

## prj.conf
```kconfig
CONFIG_PRINTK=y
# CONFIG_LOG_PRINTK=y
CONFIG_LOG=y

# 0 - OFF
# 1 - ERROR
# 2 - WARNING
# 3 - INFO
# 4 - DEBUG
CONFIG_LOG_DEFAULT_LEVEL=3

# CONFIG_MAIN_STACK_SIZE=16384

#################################################
# Bluetooth Configuration

CONFIG_BT=y
CONFIG_BT_PERIPHERAL=y

CONFIG_BT_ZEPHYR_NUS=y

CONFIG_BT_DEVICE_NAME="ZephyrTemplate"

# Below is setup to let DIS information be read from settings
CONFIG_BT_SETTINGS=y
CONFIG_SETTINGS_RUNTIME=y
CONFIG_SETTINGS=y
# CONFIG_SETTINGS_NONE=y

#################################################
# Bluetooth Device Information Service
# See zephyr/subsys/bluetooth/services/Kconfig.dis for configurations

# Enable BLE Device Information Service
CONFIG_BT_DIS=y

# Enable Settings usage in DIS
CONFIG_BT_DIS_SETTINGS=y

# DIS string stroage size (up to 248 bytes including NULL terminator)
CONFIG_BT_DIS_STR_MAX=21

# DIS model
CONFIG_BT_DIS_MODEL="Zephyr Model"

# DIS manufacturer
CONFIG_BT_DIS_MANUF="Zephyr"

# Enable DIS PnP characteristic
CONFIG_BT_DIS_PNP=y

# DIS PnP Vendor ID Source
CONFIG_BT_DIS_PNP_VID_SRC=1     

# DIS PnP Vendor ID
CONFIG_BT_DIS_PNP_VID=0x1234

# DIS PnP Product ID    
CONFIG_BT_DIS_PNP_PID=0xABCD

# DIS PnP Product Version
CONFIG_BT_DIS_PNP_VER=0xDEAD    

# Enable DIS Serial Number characteristic
CONFIG_BT_DIS_SERIAL_NUMBER=y
CONFIG_BT_DIS_SERIAL_NUMBER_STR="Zephyr Serial"

# Enable DIS Firmware Revision characteristic
CONFIG_BT_DIS_FW_REV=y
CONFIG_BT_DIS_FW_REV_STR="Zephyr Firmware"

# Enable DIS Hardware Revision characteristic
CONFIG_BT_DIS_HW_REV=y
CONFIG_BT_DIS_HW_REV_STR="Zephyr Hardware"

# Enable DIS Software Revision characteristic
CONFIG_BT_DIS_SW_REV=y
CONFIG_BT_DIS_SW_REV_STR="Zephyr Software"
```

## src/main.c
```c
/**
 * @file  main.c
 * @brief Application main entry point
 */

#include <stdbool.h>

#include <zephyr/device.h>
#include <zephyr/devicetree.h>
#include <zephyr/drivers/sensor.h>
#include <zephyr/kernel.h>

#include <ble/ble.h>

int main(void)
{
  int err;

  err = ble_init();

  if (err)
  {
    return err;
  }

  return 0;
}
```
